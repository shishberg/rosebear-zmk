## config/boards/shields/rosebear/Kconfig.defconfig
```kconfig
if SHIELD_ROSEBEAR_LEFT

config ZMK_KEYBOARD_NAME
    default "Toto"

config ZMK_SPLIT_ROLE_CENTRAL
    default y

endif

if SHIELD_ROSEBEAR_LEFT || SHIELD_ROSEBEAR_RIGHT

config ZMK_SPLIT
    default y

endif
```

## config/boards/shields/rosebear/Kconfig.shield
```kconfig
config SHIELD_ROSEBEAR_LEFT
    def_bool $(shields_list_contains,rosebear_left)

config SHIELD_ROSEBEAR_RIGHT
    def_bool $(shields_list_contains,rosebear_right)
```
